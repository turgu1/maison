#include <Arduino.h>
#include <LEDMatrixDriver.hpp>

#include "utils.h"

// The LEDMatrixDriver class instance

LEDMatrixDriver lmd(LEDMATRIX_SEGMENTS, LEDMATRIX_CS_PIN);

void init_display()
{
  // init display

  lmd.setEnabled(true);
  lmd.setIntensity(1); // 0 = low, 10 = high
  delay(10);

  lmd.clear();
  delay(10);
}

// ---- buzzer ----

void init_buzzer()
{
  pinMode(BUZZER, OUTPUT);
  digitalWrite(BUZZER, LOW);

  delay(10);
  buzz1();
}

void buzz1()
{
  digitalWrite(BUZZER, HIGH);
  delay(200);
  digitalWrite(BUZZER, LOW);
  delay(200);
}

void buzz3()
{
  for (int i = 0; i < 3; i++) {
    digitalWrite(BUZZER, HIGH);
    delay(200);
    digitalWrite(BUZZER, LOW);
    delay(200);
  }
}

// ---- blink() ----

void init_blink()
{
  pinMode(LED, OUTPUT);
  digitalWrite(LED, HIGH);
}

void blink(int count)
{
  while (count--) {
    digitalWrite(LED, LOW);
    delay(300);
    digitalWrite(LED, HIGH);
    delay(700);
  }
}

// Block font 8x8
byte font[][8] = {
    {0, 0, 0, 0, 0, 0, 0, 0},                         //space
    {0x18, 0x3C, 0x3C, 0x18, 0x18, 0x00, 0x18, 0x00}, // U+0021 (!)
    {0x36, 0x36, 0x00, 0x00, 0x00, 0x00, 0x00, 0x00}, // U+0022 (")
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    {0x6E, 0x3B, 0x00, 0x00, 0x00, 0x00, 0x00, 0x00}  // U+007E (~)
};

int x = LEDMATRIX_WIDTH, y = 0; // start top left

unsigned long myTime = millis();

/**
 * This draws a sprite to the given position using the width and height supplied (usually 8x8)
 */
void drawSprite(byte * sprite, int x, int y, int width, int height)
{
  // The mask is used to get the column bit from the sprite row
  byte mask = B10000000;

  for (int iy = 0; iy < height; iy++) {

    for (int ix = 0; ix < width; ix++) {

      //Yes my font is backwards so I swap it around.
      //lmd.setPixel(x + (width - ix), y + iy, (bool)(sprite[iy] & mask));

      lmd.setPixel(x + (width - ix), y + iy, (bool)(sprite[iy] & mask));

      // Shift the mask by one pixel to the right
      mask = mask >> 1;
    }

    // Reset column mask
    mask = B10000000;
  }
}

/**
 * This function draws a string of the given length to the given position.
 */
void drawString(char * text, int len, int x, int y)
{
  for (int idx = 0; idx < len; idx++)
  {
    int c = text[idx] - 32;

    // stop if char is outside visible area
    if ((x + idx * 8) > LEDMATRIX_WIDTH) {
      return;
    }

    // only draw if char is visible
    if ((8 + x + idx * 8) > 0) {
      drawSprite(font[c], x + (idx * 8), y, 8, 8);
    }
  }

  return;
}

/* This function is called in loop but 
 *  only does stuff when animimation delay
 *  is met. 
 *  
 *  This will allow loop to do other thing instead
 *  of waiting for a delay to happen.
 *  
 *  Delay = bad programming.
 */
bool displayText(char * theText, int len)
{
  if ((myTime + ANIM_DELAY) < millis()) {

    myTime = millis();

    // Draw the text to the current position
    drawString(theText, len, x, 0);

    // In case you wonder why we don't have to call lmd.clear() in every loop:
    // The font has a opaque (black) background...
    // Toggle display of the new framebuffer
    lmd.display();

    // Advance to next coordinate
    if (--x < (len * -8)) {
      x = LEDMATRIX_WIDTH;
      lmd.clear();
      return true; // The text has been shown completly
    }
  }
  return false; // Still something to do
}
